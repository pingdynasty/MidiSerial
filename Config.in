## Config.in
```kconfig
config BR2_PACKAGE_MIDISERIAL
        bool "midiserial"
        select BR2_PACKAGE_PKGCONFIG
        help
          MIDISERIAL is a midi to serialmessage router.
	  Code licensed under Gnu GPG
```
